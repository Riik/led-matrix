#include <SPI.h>

SPISettings settingsA(16000, MSBFIRST, SPI_MODE0);
static int pinout = 9;
void setup() {
  SPI.begin();
  SPI.beginTransaction(settingsA);
  pinMode(7, OUTPUT);
  pinMode(8, OUTPUT);
  pinMode(9, OUTPUT);
  pinMode(10, OUTPUT);
  digitalWrite(7, LOW);
  digitalWrite(8, LOW);
  digitalWrite(9, LOW);
  digitalWrite(10, LOW);
}

/*
  static const uint8_t data[] = {
  0x8, 0xc, 0xe, 0xff, 0xff, 0xe, 0xc, 0x8, 0x0,
  0x24, 0x24, 0x7e, 0xdb, 0xff, 0xff, 0xa5, 0x24, 0x0,
  0xe1, 0x1a, 0x44, 0x2a, 0x12, 0x29, 0xc5, 0x41, 0x0,
  0xff, 0xc3, 0xa5, 0x0, 0x66, 0xbd, 0xc3, 0xff, 0x0,
  0x3c,0x7e,0xf7,0xf8,0xe0,0xf8,0x7e,0x3c,0x0,
  };*/

static const uint8_t data[] = {
  0x0, 0x0, 0x0, 0x0, 0x0, 0x3c, 0x5a, 0xff,
  0x0, 0x0, 0x3c, 0x5a, 0x7e, 0x66, 0x7e, 0x3c,
  0x0, 0x0, 0x0, 0x0, 0x0, 0x3c, 0x5a, 0xff,
  0x0, 0x0, 0x3c, 0x5a, 0x7e, 0x66, 0x7e, 0x3c,
  0x0, 0x3c, 0x5a, 0x7e, 0x42, 0x42, 0x24, 0x18,
};

void loop() {
  // put your main code here, to run repeatedly:
  for (int j = 0; j < sizeof(data) / 8; ++j) {
    for (int k = 0; k < 50; ++k) {
      for (int i = 0; i < 8; ++i) {
        size_t index = i + j * 8;
        uint8_t val = data[index];
        SPI.transfer(val);
        digitalWrite(7, HIGH);
        digitalWrite(7, LOW);

        digitalWrite(8, i & 0x1 ? HIGH : LOW);
        digitalWrite(9, i & 0x2 ? HIGH : LOW);
        digitalWrite(10, i & 0x4 ? HIGH : LOW);
        delay(1);
      }
    }
  }

}
